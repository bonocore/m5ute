/****************************************************************
 * 
 * A simple BLE mute button
 * 
 * See github.com/
 * 
 * Arduino tools Setting 
 * -board : M5StickC
 * -Upload Speed: 115200 / 750000 / 1500000
 * 
****************************************************************/
#include "M5Atom.h"
#include <BLEDevice.h>
#include <BLEUtils.h>
#include <BLEServer.h>



const unsigned char image_bellGreen[77]=
{
/* width  005 */ 0x05,
/* height 005 */ 0x05,
/* Line   000 */ 0x00,0x00,0x00, 0x00,0x00,0x00, 0x00,0xaa,0x00, 0x00,0x00,0x00, 0x00,0x00,0x00, // 
/* Line   001 */ 0x00,0x00,0x00, 0x00,0xaa,0x00, 0x00,0xaa,0x00, 0x00,0xaa,0x00, 0x00,0x00,0x00, // 
/* Line   002 */ 0x00,0x00,0x00, 0x00,0xaa,0x00, 0x00,0x00,0x00, 0x00,0xaa,0x00, 0x00,0x00,0x00, // 
/* Line   003 */ 0x00,0xaa,0x00, 0x00,0xaa,0x00, 0x00,0xaa,0x00, 0x00,0xaa,0x00, 0x00,0xaa,0x00, // 
/* Line   004 */ 0x00,0x00,0x00, 0x00,0x00,0x00, 0x00,0xaa,0x00, 0x00,0x00,0x00, 0x00,0x00,0x00, // 
};

const unsigned char image_bellRed[77]=
{
/* width  005 */ 0x05,
/* height 005 */ 0x05,
/* Line   000 */ 0x00,0x00,0x00, 0x00,0x00,0x00, 0xff,0x00,0x00, 0x00,0x00,0x00, 0x00,0x00,0x00, // 
/* Line   001 */ 0x00,0x00,0x00, 0xff,0x00,0x00, 0xff,0x00,0x00, 0xff,0x00,0x00, 0x00,0x00,0x00, // 
/* Line   002 */ 0x00,0x00,0x00, 0xff,0x00,0x00, 0x00,0x00,0x00, 0xff,0x00,0x00, 0x00,0x00,0x00, // 
/* Line   003 */ 0xff,0x00,0x00, 0xff,0x00,0x00, 0xff,0x00,0x00, 0xff,0x00,0x00, 0xff,0x00,0x00, // 
/* Line   004 */ 0x00,0x00,0x00, 0x00,0x00,0x00, 0xff,0x00,0x00, 0x00,0x00,0x00, 0x00,0x00,0x00, // 
};

const unsigned char image_bellYellow[77]=
{
/* width  005 */ 0x05,
/* height 005 */ 0x05,
/* Line   000 */ 0x00,0x00,0x00, 0x00,0x00,0x00, 0xff,0xff,0x00, 0x00,0x00,0x00, 0x00,0x00,0x00, // 
/* Line   001 */ 0x00,0x00,0x00, 0xff,0xff,0x00, 0xff,0xff,0x00, 0xff,0xff,0x00, 0x00,0x00,0x00, // 
/* Line   002 */ 0x00,0x00,0x00, 0xff,0xff,0x00, 0x00,0x00,0x00, 0xff,0xff,0x00, 0x00,0x00,0x00, // 
/* Line   003 */ 0xff,0xff,0x00, 0xff,0xff,0x00, 0xff,0xff,0x00, 0xff,0xff,0x00, 0xff,0xff,0x00, // 
/* Line   004 */ 0x00,0x00,0x00, 0x00,0x00,0x00, 0xff,0xff,0x00, 0x00,0x00,0x00, 0x00,0x00,0x00, // 
};

const unsigned char image_bellYellowNegative[77]=
{
/* width  005 */ 0x05,
/* height 005 */ 0x05,
/* Line   000 */ 0xff,0xff,0x00, 0xff,0xff,0x00, 0x00,0x00,0x00, 0xff,0xff,0x00, 0xff,0xff,0x00, // 
/* Line   001 */ 0xff,0xff,0x00, 0x00,0x00,0x00, 0x00,0x00,0x00, 0x00,0x00,0x00, 0xff,0xff,0x00, // 
/* Line   002 */ 0xff,0xff,0x00, 0x00,0x00,0x00, 0xff,0xff,0x00, 0x00,0x00,0x00, 0xff,0xff,0x00, // 
/* Line   003 */ 0x00,0x00,0x00, 0x00,0x00,0x00, 0x00,0x00,0x00, 0x00,0x00,0x00, 0x00,0x00,0x00, // 
/* Line   004 */ 0xff,0xff,0x00, 0xff,0xff,0x00, 0x00,0x00,0x00, 0xff,0xff,0x00, 0xff,0xff,0x00, // 
};
bool isMute = false;
BLECharacteristic* muteButtonCharacteristic = NULL;
BLECharacteristic* muteStatusCharacteristic = NULL;
bool deviceConnected = false;


#define SERVICE_UUID        "25520668-f5d1-4ffb-9ef9-357794ecaea6"
#define MUTE_BUTTON_CHARACTERISTIC_UUID "e4004f12-e8ff-4a94-a8a8-919efc07605e"
#define MUTE_STATUS_CHARACTERISTIC_UUID "586c30af-afc9-4c0d-870a-5cee22b11a38"

class MyServerCallbacks: public BLEServerCallbacks {
    void onConnect(BLEServer* pServer) {
      deviceConnected = true;
         if (isMute)
       {
          M5.dis.displaybuff( (uint8_t *) image_bellGreen);
       }else
       {
          M5.dis.displaybuff( (uint8_t *) image_bellRed);
       }
   
    };

    void onDisconnect(BLEServer* pServer) {
      deviceConnected = false;
    }
};

void setup()
{
    
    M5.begin(true, false, true);
    Serial.begin(115200);
    delay(10);
    M5.dis.displaybuff( (uint8_t *) image_bellGreen);
    BLEDevice::init("M5ute");
    BLEServer *pServer = BLEDevice::createServer();
    pServer->setCallbacks(new MyServerCallbacks());
    BLEService *pService = pServer->createService(SERVICE_UUID);
    muteButtonCharacteristic = pService->createCharacteristic(
                      MUTE_BUTTON_CHARACTERISTIC_UUID,
                      BLECharacteristic::PROPERTY_READ   |
                      BLECharacteristic::PROPERTY_WRITE  |
                      BLECharacteristic::PROPERTY_NOTIFY |
                      BLECharacteristic::PROPERTY_INDICATE
                    );
    muteStatusCharacteristic = pService->createCharacteristic(
                      MUTE_STATUS_CHARACTERISTIC_UUID,
                      BLECharacteristic::PROPERTY_READ   |
                      BLECharacteristic::PROPERTY_WRITE  
                    );

    pService->start();
    BLEAdvertising *pAdvertising = BLEDevice::getAdvertising();
    pAdvertising->addServiceUUID(SERVICE_UUID);
    pAdvertising->setScanResponse(true);
    BLEDevice::startAdvertising();
}

void loop()
{
    //blinking if not connected
    if (!deviceConnected) {
      M5.dis.displaybuff( (uint8_t *) image_bellYellow);
      M5.update();
      delay(1000); 
      M5.dis.displaybuff( (uint8_t *) image_bellYellowNegative);
      M5.update();
      delay(1000); 
     return;
    }

    
    //Serial.print(muteStatusCharacteristic->getValue().c_str());
    
    if(muteStatusCharacteristic->getValue() == "MUTED")
    {
      M5.dis.displaybuff( (uint8_t *) image_bellRed);
    }else
    {
      M5.dis.displaybuff( (uint8_t *) image_bellGreen); 
    }
    //delay(3000); 
    //managing btn actions
    if (M5.Btn.wasPressed())
    {
         //muteButtonCharacteristic->setValue("UNMUTE");
         muteButtonCharacteristic->notify();
    }
    M5.update();
}
